## drivers/soc/oplus/owakelock/Kconfig
```kconfig
#code deprecated ... start (Todo : delete this code section)


#code deprecated ... end (Todo : delete this code section)





#ifdef OPLUS_FEATURE_POWERINFO_RPMH
config OPLUS_POWERINFO_RPMH
bool "powerinfo rpmh config"
default n
help
    Select this config to enable powerinfo rpmh
#endif /* OPLUS_FEATURE_POWERINFO_RPMH */

#ifdef OPLUS_FEATURE_POWERINFO_FTM
config OPLUS_POWERINFO_FTM
bool "powerinfo ftm config"
default n
help
    Select this config to enable powerinfo ftm
#endif /* OPLUS_FEATURE_POWERINFO_FTM */
```
